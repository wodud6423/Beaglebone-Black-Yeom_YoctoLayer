## conf/layer.conf
```bitbake
# meta-yeom/conf/layer.conf
BBPATH := "${BBPATH}"
BBFILES += "{LAYERDIR}/recipes-*/*/*.bb \
		${LAYERDIR}/recipes-*/*/*.bbappend"

# layer metadata
LAYERVERSION="1"
LAYERNAME="meta-yeom"

# Need Layer
LAYERDEPENDS="core"
BBFILE_COLLECTIONS += "yeom"
BBFILE_PATTERN_yeom := "^${LAYERDIR}/"
BBFILE_PRIORITY_yeom = "10"
# LAYERSERIES_COMPAT_yeom = "${LAYERSERIES_COMPAT_core}"
```
